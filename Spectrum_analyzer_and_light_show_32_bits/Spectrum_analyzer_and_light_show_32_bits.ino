#include "Arduino.h"

// полная длина входных значений
#define N_WAVE  1024
// log2(N_WAVE) 
#define LOG2_N_WAVE 10   

// частота выборок, определённая экспериментальным путём
#define SAMPLE_FREQ 48166

// размер одного буфера
#define BUFFER_SIZE 1024 
// кол-во буферов для DMA
#define BUFFER_COUNT 4 

// накладывать ли окно на входные данные перед преобразованием Фурье
#define APPLY_WINDOW

// основане логарифма выходной шкалы частот спектроанализатора
// OUTPUT_LOG_BASE = (N_WAVE / 2) ^ (1 / N_OUTPUT), где N_OUTPUT - кол-во выходных полос
// для N_OUTPUT = 50, OUTPUT_LOG_BASE = 1.105
// для N_OUTPUT = 3, OUTPUT_LOG_BASE = 16
#define OUTPUT_LOG_BASE 1.105

// основание логарифма в представлении с фиксированной точкой
#define OUTPUT_LOG_BASE_FIX ((int16_t) ((int32_t) (INT16_MAX + 1) * (1.0 - 1.0 / OUTPUT_LOG_BASE)))

 // кол-во пропущенных циклов при калибровке
#define CALIBRATION_DUMMY_LOOPS 30
 // кол-во используемых циклов в вычислении среднего  при калибровке
#define CALIBRATION_WORK_LOOPS 30

// чувствительность к перегрузке по уровню
//#define OVERLOAD_TOLERANCE 200 
 // чувствительность к перегрузке по кол-ву выборок
#define OVERLOAD_DETECTION_THRESHOLD 5
// минимальное кол-во уровней, при котором включается алгоритм обнаружения перегрузки [1; NUM_LEVEL_COUNTERS]
#define MIN_OVERLOAD_DETECTION_LEVEL 128

#define NUM_LEVEL_COUNTERS 256

#if (UINT16_MAX + 1) % NUM_LEVEL_COUNTERS != 0
#  error 65536 должно нацело делиться на NUM_LEVEL_COUNTERS 
#endif

 // коэффициент для перевода в ШИМ сигнал
#define PWM_CHANNEL_RATIO (1 << 11)

 // номер пина низкочастотного канала
#define PWM_PIN_LOW 11
// номер пина среднечастотного канала
#define PWM_PIN_MID 12
// номер пина высокочастотного канала
#define PWM_PIN_HIGH 2 

#define OVERLOAD_LED 13

#ifdef DEBUG_COUNT
int count = 0;
#endif

volatile int i_buf_index, o_buf_index; // индексы буферов

int pwm_pins[3] = {PWM_PIN_LOW, PWM_PIN_MID, PWM_PIN_HIGH}; // массив с номерами ШИМ каналов ардуино

int16_t dc_level; // уровень постоянной составляющей

int16_t buffer[BUFFER_COUNT][BUFFER_SIZE]; // буфер для внутренней памяти
int16_t im[N_WAVE]; // массив im

// структура, определяющая диапазон частотных полос
typedef struct {
  int start_band;
  int stop_band;
} band_t;

typedef struct {
  int16_t band_count;
  int16_t level;
} band_data_t;

// массив с диапазонами частотных полос
const band_t band_defs[3] = {
  { start_band : 1, stop_band : 5, }, // 0 - 200 Гц
  { start_band : 6, stop_band : 20, }, // 200 - 800 Гц
  { start_band : 21, stop_band : 511, }, // 1000 - 20000 Гц
};

// Since we only use 3/4 of N_WAVE, we define only this many samples, in order to conserve data space.
const int16_t Sinewave[N_WAVE-N_WAVE/4] = {
 0,	202,	403,	604,	805,	1006,	1207,	1408,	
1608,	1809,	2010,	2211,	2411,	2612,	2812,	3012,	
3212,	3412,	3612,	3812,	4012,	4211,	4410,	4610,	
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-32728,	-32737,	-32745,	-32752,	-32758,	-32762,	-32765,	-32767,	

/* -32768,	-32767,	-32765,	-32762,	-32758,	-32752,	-32745,	-32737,	
-32728,	-32718,	-32706,	-32693,	-32679,	-32663,	-32647,	-32629,	
-32610,	-32589,	-32568,	-32545,	-32521,	-32496,	-32469,	-32442,	
-32413,	-32383,	-32351,	-32319,	-32285,	-32250,	-32214,	-32176,	
-32138,	-32098,	-32057,	-32015,	-31971,	-31927,	-31881,	-31834,	
-31785,	-31736,	-31685,	-31634,	-31581,	-31526,	-31471,	-31414,	
-31357,	-31298,	-31237,	-31176,	-31114,	-31050,	-30985,	-30919,	
-30852,	-30784,	-30714,	-30644,	-30572,	-30499,	-30425,	-30350,	
-30273,	-30196,	-30117,	-30037,	-29956,	-29874,	-29791,	-29707,	
-29621,	-29535,	-29447,	-29359,	-29269,	-29178,	-29086,	-28993,	
-28898,	-28803,	-28707,	-28609,	-28511,	-28411,	-28310,	-28208,	
-28106,	-28002,	-27897,	-27791,	-27684,	-27576,	-27466,	-27356,	
-27245,	-27133,	-27020,	-26905,	-26790,	-26674,	-26557,	-26438,	
-26319,	-26199,	-26077,	-25955,	-25832,	-25708,	-25583,	-25457,	
-25330,	-25201,	-25073,	-24943,	-24812,	-24680,	-24547,	-24414,	
-24279,	-24144,	-24007,	-23870,	-23732,	-23593,	-23453,	-23312,	
-23170,	-23027,	-22884,	-22740,	-22594,	-22448,	-22301,	-22154,	
-22005,	-21856,	-21706,	-21555,	-21403,	-21250,	-21097,	-20942,	
-20787,	-20631,	-20475,	-20318,	-20159,	-20001,	-19841,	-19681,	
-19519,	-19358,	-19195,	-19032,	-18868,	-18703,	-18537,	-18371,	
-18204,	-18037,	-17869,	-17700,	-17530,	-17360,	-17189,	-17018,	
-16846,	-16673,	-16499,	-16325,	-16151,	-15976,	-15800,	-15623,	
-15446,	-15269,	-15090,	-14912,	-14732,	-14552,	-14372,	-14191,	
-14010,	-13828,	-13645,	-13462,	-13278,	-13094,	-12910,	-12725,	
-12539,	-12353,	-12167,	-11980,	-11793,	-11605,	-11416,	-11228,	
-11039,	-10849,	-10659,	-10469,	-10278,	-10087,	-9896,	-9704,	
-9512,	-9319,	-9126,	-8933,	-8739,	-8545,	-8351,	-8156,	
-7961,	-7766,	-7571,	-7375,	-7179,	-6983,	-6786,	-6589,	
-6392,	-6195,	-5997,	-5800,	-5602,	-5403,	-5205,	-5006,	
-4808,	-4609,	-4409,	-4210,	-4011,	-3811,	-3611,	-3411,	
-3211,	-3011,	-2811,	-2611,	-2410,	-2210,	-2009,	-1808,	
-1607,	-1407,	-1206,	-1005,	-804,	-603,	-402,	-201,*/

};
 
/*
  FIX_MPY() - fixed-point multiplication & scaling.
  Substitute inline assembly for hardware-specific
  optimization suited to a particluar DSP processor.
  Scaling ensures that result remains 16-bit.
*/
inline int16_t FIX_MPY(int16_t a, int16_t b)
{   
    int32_t c = ((int32_t)a * (int32_t)b) >> (sizeof(a) * 8 - 2);

    b = c & 0x01;
    a = (c >> 1) + b;
 
    return a;
}
 
/*
  fix_fft() - perform forward/inverse fast Fourier transform.
  fr[n],fi[n] are real and imaginary arrays, both INPUT AND
  RESULT (in-place FFT), with 0 <= n < 2**m; set inverse to
  0 for forward transform (FFT), or 1 for iFFT.
*/
int16_t fix_fft(int16_t fr[], int16_t fi[], int m, int inverse)
{
  int16_t mr, nn, i, j, l, k, istep, n, scale, shift;
  int16_t qr, qi, tr, ti, wr, wi;
 
  int16_t max_val = (~((typeof(fr[0])) 0)) >> 2;
 
  n = 1 << m;
 
   /* max FFT size = N_WAVE */
  if (n > N_WAVE)
    return -1;

  mr = 0;
  nn = n - 1;
  scale = 0;
 
  /* decimation in time - re-order data */
  for (m=1; m<=nn; ++m) {
    l = n;
    do {
      l >>= 1;
    } while (mr+l > nn);
    mr = (mr & (l-1)) + l;
 
    if (mr <= m)
      continue;
    tr = fr[m];
    fr[m] = fr[mr];
    fr[mr] = tr;
    ti = fi[m];
    fi[m] = fi[mr];
    fi[mr] = ti;
  }
 
  l = 1;
  k = LOG2_N_WAVE-1;
  while (l < n) {
    if (inverse) {
      /* variable scaling, depending upon data */
      shift = 0;
      for (i=0; i<n; ++i) {
          j = fr[i];
          if (j < 0)
            j = -j;
          m = fi[i];
          if (m < 0)
            m = -m;
          if (j > max_val || m > max_val) {
            shift = 1;
            break;
          }
      }
      if (shift)
          ++scale;
    } else {
      /*
        fixed scaling, for proper normalization --
        there will be log2(n) passes, so this results
        in an overall factor of 1/n, distributed to
        maximize arithmetic accuracy.
      */
      shift = 1;
    }
    /*
      it may not be obvious, but the shift will be
      performed on each data point exactly once,
      during this pass.
    */
    istep = l << 1;
    for (m=0; m<l; ++m) {
      j = m << k;
      /* 0 <= j < N_WAVE/2 */
      wr = Sinewave[j+N_WAVE/4];
        
 
      wi = -Sinewave[j];
      if (inverse)
          wi = -wi;
      if (shift) {
          wr >>= 1;
          wi >>= 1;
      }
      for (i=m; i<n; i+=istep) {
          j = i + l;
          tr = FIX_MPY(wr,fr[j]) - FIX_MPY(wi,fi[j]);
          ti = FIX_MPY(wr,fi[j]) + FIX_MPY(wi,fr[j]);
          qr = fr[i];
          qi = fi[i];
          if (shift) {
            qr >>= 1;
            qi >>= 1;
          }
          fr[j] = qr - tr;
          fi[j] = qi - ti;
          fr[i] = qr + tr;
          fi[i] = qi + ti;
      }
    }
    --k;
    l = istep;
  }
  return scale;
}
 
/*
  fix_fftr() - forward/inverse FFT on array of real numbers.
  Real FFT/iFFT using half-size complex FFT by distributing
  even/odd samples into real/imaginary arrays respectively.
  In order to save data space (i.e. to avoid two arrays, one
  for real, one for imaginary samples), we proceed in the
  following two steps: a) samples are rearranged in the real
  array so that all even samples are in places 0-(N/2-1) and
  all imaginary samples in places (N/2)-(N-1), and b) fix_fft
  is called with fr and fi pointing to index 0 and index N/2
  respectively in the original array. The above guarantees
  that fix_fft "sees" consecutive real samples as alternating
  real and imaginary samples in the complex array.
*/
int fix_fftr(int16_t f[], int m, int inverse)
{
    int i, N = 1<<(m-1), scale = 0;
    int16_t tt, *fr=f, *fi=&f[N];
 
    if (inverse)
      scale = fix_fft(fi, fr, m-1, inverse);
    for (i=1; i<N; i+=2) {
      tt = f[N+i-1];
      f[N+i-1] = f[i];
      f[i] = tt;
    }
    if (! inverse)
      scale = fix_fft(fi, fr, m-1, inverse);
    return scale;
}

// Blackman window weights for 512 points.
static const int16_t blackman_window[N_WAVE / 2] = {
0, 0, 0, 0, 1, 2, 3, 5,
 7, 9, 11, 13, 16, 18, 21, 25,
 28, 32, 36, 40, 44, 49, 54, 59,
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 32734, 32742, 32748, 32754, 32758, 32762, 32764, 32766,
 
 /*32766, 32766, 32764, 32762, 32758, 32754, 32748, 32742,
 32734, 32726, 32716, 32705, 32694, 32681, 32667, 32653,
 32637, 32621, 32603, 32584, 32565, 32544, 32522, 32500,
 32476, 32452, 32426, 32400, 32372, 32344, 32314, 32284,
 32252, 32220, 32186, 32152, 32117, 32080, 32043, 32005,
 31966, 31926, 31885, 31843, 31800, 31756, 31712, 31666,
 31619, 31572, 31523, 31474, 31424, 31373, 31321, 31268,
 31214, 31159, 31103, 31047, 30990, 30931, 30872, 30812,
 30752, 30690, 30627, 30564, 30500, 30435, 30369, 30303,
 30235, 30167, 30098, 30028, 29957, 29886, 29814, 29741,
 29667, 29592, 29517, 29441, 29364, 29287, 29209, 29130,
 29050, 28970, 28888, 28807, 28724, 28641, 28557, 28472,
 28387, 28301, 28215, 28128, 28040, 27951, 27862, 27772,
 27682, 27591, 27499, 27407, 27314, 27221, 27127, 27033,
 26938, 26842, 26746, 26649, 26552, 26454, 26356, 26257,
 26158, 26058, 25958, 25857, 25756, 25654, 25552, 25450,
 25347, 25243, 25139, 25035, 24930, 24825, 24719, 24613,
 24507, 24401, 24293, 24186, 24078, 23970, 23862, 23753,
 23644, 23534, 23425, 23315, 23204, 23094, 22983, 22872,
 22760, 22649, 22537, 22425, 22312, 22200, 22087, 21974,
 21861, 21747, 21634, 21520, 21406, 21292, 21178, 21063,
 20949, 20834, 20719, 20604, 20489, 20374, 20259, 20144,
 20028, 19913, 19797, 19682, 19566, 19451, 19335, 19219,
 19104, 18988, 18872, 18756, 18641, 18525, 18409, 18293,
 18178, 18062, 17947, 17831, 17716, 17600, 17485, 17370,
 17255, 17140, 17025, 16910, 16795, 16681, 16566, 16452,
 16338, 16224, 16110, 15996, 15883, 15770, 15656, 15543,
 15431, 15318, 15206, 15094, 14982, 14870, 14758, 14647,
 14536, 14425, 14315, 14204, 14094, 13985, 13875, 13766,
 13657, 13548, 13440, 13332, 13224, 13117, 13010, 12903,
 12797, 12690, 12585, 12479, 12374, 12269, 12165, 12061,
 11957, 11853, 11750, 11648, 11546, 11444, 11342, 11241,
 11140, 11040, 10940, 10840, 10741, 10643, 10544, 10446,
 10349, 10252, 10155, 10059, 9963, 9868, 9773, 9679,
 9585, 9491, 9398, 9306, 9213, 9122, 9030, 8940,
 8849, 8759, 8670, 8581, 8493, 8405, 8317, 8230,
 8144, 8058, 7972, 7887, 7802, 7718, 7635, 7552,
 7469, 7387, 7305, 7224, 7144, 7063, 6984, 6905,
 6826, 6748, 6671, 6593, 6517, 6441, 6365, 6290,
 6216, 6142, 6068, 5995, 5923, 5851, 5780, 5709,
 5638, 5568, 5499, 5430, 5362, 5294, 5227, 5160,
 5094, 5028, 4963, 4898, 4834, 4770, 4707, 4644,
 4582, 4521, 4459, 4399, 4339, 4279, 4220, 4161,
 4103, 4046, 3988, 3932, 3876, 3820, 3765, 3710,
 3656, 3603, 3550, 3497, 3445, 3393, 3342, 3291,
 3241, 3191, 3142, 3093, 3045, 2997, 2950, 2903,
 2857, 2811, 2765, 2720, 2676, 2632, 2588, 2545,
 2502, 2460, 2418, 2377, 2336, 2295, 2255, 2216,
 2177, 2138, 2100, 2062, 2025, 1988, 1951, 1915,
 1879, 1844, 1809, 1775, 1741, 1707, 1674, 1641,
 1608, 1576, 1545, 1514, 1483, 1452, 1422, 1393,
 1363, 1334, 1306, 1278, 1250, 1222, 1195, 1169,
 1142, 1116, 1091, 1066, 1041, 1016, 992, 968,
 945, 922, 899, 876, 854, 832, 811, 790,
 769, 749, 728, 709, 689, 670, 651, 632,
 614, 596, 578, 561, 544, 527, 511, 495,
 479, 463, 448, 433, 418, 404, 390, 376,
 362, 349, 336, 323, 311, 298, 286, 275,
 263, 252, 241, 230, 220, 210, 200, 190,
 181, 172, 163, 154, 146, 138, 130, 122,
 115, 108, 101, 94, 87, 81, 75, 69,
 64, 59, 54, 49, 44, 40, 36, 32,
 28, 25, 21, 18, 16, 13, 11, 9,
 7, 5, 3, 2, 1, 0, 0, 0,
 0,*/
};

static int apply_window(int16_t *data, int m, const int16_t *window)
{
  if (m < 1 || m > LOG2_N_WAVE) {
    return -1;
  }

  int half = 1 << (m - 1);
  int w_step = 1 << (LOG2_N_WAVE - m);

  int size = half;
  const int16_t *w_ptr = &window[w_step - 1];

  while (size-- > 0) {
    *data = FIX_MPY(*data, *w_ptr);
    data++;
    w_ptr += w_step;
  }

  size = half;
  w_ptr = &window[N_WAVE / 2 - 1];

  while (size-- > 0) {
    *data = FIX_MPY(*data, *w_ptr);
    data++;
    w_ptr -= w_step;
  }

  return 0;
}

// функция окна блэкмана
int apply_blackman_window(int16_t *data, int m) {
  return apply_window(data, m, blackman_window);
}

int16_t sin_i(int x, int t, int s, int16_t a) {
  x = ((x / s) % t) * N_WAVE / t;
    
  int16_t y = Sinewave[x % (N_WAVE / 2)];
    
  if (x >= N_WAVE / 2) {
    y = -y;
  }
  
  return FIX_MPY(y, a);
}

void ADC_Handler() {
  int adc_isr = ADC->ADC_ISR;
  
  if (adc_isr & ADC_ISR_ENDRX) {
    // заполнен очередной буфер, передаём контоллеру доступа следующий буфер

    int next_buf_index = (i_buf_index + 2) % BUFFER_COUNT;
    
    if (next_buf_index != o_buf_index) {
      // В кольцевом буфере есть место под новый "next" блок данных.
      // Продвигаем указатель.
      i_buf_index = (i_buf_index + 1) % BUFFER_COUNT;
    }
    else {
      // Переполнение кольцевого буфера.
      // "next" блок данных будет отброшен и заполнен заново.
      // i_buf_index не меняется.
      next_buf_index = (i_buf_index + 1) % BUFFER_COUNT;
    }
    
    ADC->ADC_RNPR = (uint32_t) buffer[next_buf_index];
    ADC->ADC_RNCR = BUFFER_SIZE;
  }
}

int16_t *get_adc_buffer() {
  while (o_buf_index == i_buf_index);
  
  return buffer[o_buf_index];
}

// процедуа полученеия свободного буфера
void free_adc_buffer() {
  if (o_buf_index != i_buf_index) {
    o_buf_index = (o_buf_index + 1) % BUFFER_COUNT;
  }
}

// функция извлечения квадратного корня из числа с фиксированной точкой
int16_t sqrt_i(int16_t x) {
 int16_t a, b;
 int32_t xdp = ((int32_t) x) << 16;

 a = 0;
 b = INT16_MAX;

  while (b - a > 1) {
    int16_t m = (a + b) / 2;
    int32_t sq = (((int32_t) m) * m) << 1;

    if (sq > xdp) {
      b = m;
    }
    else {
      a = m;
    }
  }

  if (abs(((((int32_t) a) * a) << 1) - xdp) < abs(((((int32_t) b) * b) << 1) - xdp)) {
    return a;
  }
  else {
    return b;
  }
}

/* функция расчёта значения x. Возвращает: 
  min_value, когда x < min_value;
  max_value, когда x > max_value
  в потивном случае x
*/
inline int limit(int x, int min_value, int max_value) {
  if (x < min_value) {
    return min_value;
  }
  else if (x > max_value) {
    return max_value;
  }
  
  return x;
}

// функция перевода из уровня сигнала в уровень ШИМ
inline uint8_t signal_to_pwm(int16_t sig_value) {
  return limit(FIX_MPY(sig_value, PWM_CHANNEL_RATIO), 0, 255);
}

// поиск индекса максимума в массиве x[size]
size_t max_array_element(const int16_t *x, size_t size) {
  int16_t max_value = x[0];
  size_t max_index = 0;
  
  for (size_t i = 1; i < size; i++) {
    if (x[i] > max_value) {
      max_value = x[i];
      max_index = i;
    }
  }
  
  return max_index;
}

void word_to_bytes(uint16_t val, byte& high, byte& low) {
  high = (val >> 8) & 0xff;
  low = val & 0xff;
}

void write_word(uint16_t value) {
  byte high, low;
  word_to_bytes(value, high, low);
  Serial.write(high);
  Serial.write(low);  
}

void write_data(const band_data_t* data, int data_size) {
  for (int i = 0; i < data_size; i++) {
    write_word(data[i].band_count);
    write_word(data[i].level);
  }
}

void write_packet(const band_data_t* data, int data_size, uint16_t max_level, uint16_t peak_index, uint16_t log_base, uint16_t sample_freq, uint16_t n_wave) {
  write_word(0xffff);
  write_word(max_level);
  write_word(peak_index);
  write_word(log_base);
  write_word(sample_freq);
  write_word(n_wave);
  write_word(data_size);  
  write_data(data, data_size);  
  write_word(0x0000);
}

void reverse(band_data_t* data, int size) {
  for (int i = 0, j = size - 1; i < j; i++, j--) {
    band_data_t tmp = data[i];
    data[i] = data[j];
    data[j] = tmp;
  }
}

void setup() {
  Serial.begin(115200); // Устанавливает скорость порта на 115200 Бод
  
  i_buf_index = o_buf_index = 0; // начальные установки АЦП
  
  adc_init(ADC, SystemCoreClock, ADC_FREQ_MIN, ADC_STARTUP_NORM); // инициализация АЦП ADC_FREQ_MIN = 1000000 (1 MHz)
  adc_configure_timing(ADC, 0, ADC_SETTLING_TIME_3, 1); // 23 periods ADC_FREQ per 1 conversion (43478.26 Hz)
  adc_configure_trigger(ADC, ADC_TRIG_SW, 1);
  adc_disable_interrupt(ADC, 0xFFFFFFFF);
  adc_disable_all_channel(ADC); // запрет АЦП на всех каналах
  
  adc_enable_channel(ADC, ADC_CHANNEL_7); // разрешение АЦП на 7 канале МК (А0)
  
  adc_enable_interrupt(ADC, ADC_IER_ENDRX); // разрешаем прерывание по готовности буфера прямого доступа в память
  
  // инициализиуем прямой доступ в память
  ADC->ADC_RPR = (uint32_t) buffer[0]; 
  ADC->ADC_RCR = BUFFER_SIZE;
  ADC->ADC_RNPR = (uint32_t) buffer[1];
  ADC->ADC_RNCR = BUFFER_SIZE;
  ADC->ADC_PTCR = ADC_PTCR_RXTEN; // разрешаем прямой доступ в память
  
  NVIC_EnableIRQ(ADC_IRQn); // разрешение прерывания от АЦП в контроллере прерываний
  
  adc_start(ADC); // запуск АЦП
  
  // калибровка  
  // заполняем и чистим буфер информации - заряжаем конденсатор АЦП для последующего вычисления постоянной составляюей
  for(int i = 0; i < CALIBRATION_DUMMY_LOOPS; i++) {
    get_adc_buffer();
    free_adc_buffer();
  }
  
  // вычисляем постоянную составляющую сигнала
  int32_t sum = 0;
  
  for(int i = 0; i < CALIBRATION_WORK_LOOPS; i++) {
    int16_t *data = get_adc_buffer();
    for(int j = 0; j < BUFFER_SIZE; j++) { 
      sum += data[j];
    }
    
    free_adc_buffer();
  }
  
  dc_level = sum / (CALIBRATION_WORK_LOOPS * BUFFER_SIZE);
  
  // конфигурируем порты ШИМ на выход и подтягиваем их к 0
  for(int i = 0; i < 3; i++) {
    pinMode(pwm_pins[i], OUTPUT);
    digitalWrite(pwm_pins[i], 0);
  }
  
  pinMode(OVERLOAD_LED, OUTPUT);
  digitalWrite(OVERLOAD_LED, 0);
}

void loop() { 
  int16_t *data = get_adc_buffer(); // получаем данные преобазованич от АЦП в массив data
  int16_t channels[3]; // переменная, хранящая амплитуды сигналов
  
  // счётчики уровней сигнала
  int16_t level_counters[NUM_LEVEL_COUNTERS];
  
  // устанавливаем все счётчики в ноль
  memset(level_counters, 0, sizeof(level_counters));
  
  for (int i = 0; i < BUFFER_SIZE; i++) {  
    data[i] = ((data[i] - dc_level) << 4);
    im[i] = 0;
    int16_t level_counter_index = data[i] / ((UINT16_MAX + 1) / NUM_LEVEL_COUNTERS) + NUM_LEVEL_COUNTERS / 2;
    level_counters[level_counter_index]++;    
  }
  
  int min_level_counter_index;
  int max_level_counter_index;
  
  for (min_level_counter_index = 0; min_level_counter_index < NUM_LEVEL_COUNTERS && level_counters[min_level_counter_index] == 0; min_level_counter_index++)
    ;  
  
  for (max_level_counter_index = NUM_LEVEL_COUNTERS - 1; max_level_counter_index > min_level_counter_index && level_counters[max_level_counter_index] == 0; max_level_counter_index--)
    ;
  
  int is_overload = 0;
  
  if (max_level_counter_index - min_level_counter_index > MIN_OVERLOAD_DETECTION_LEVEL) {
    int16_t level_counters_max = 0;
  
    for (int i = 0; i < 4; i++) {
      int max_index = max_array_element(level_counters, NUM_LEVEL_COUNTERS);
      level_counters_max += level_counters[max_index];
      level_counters[max_index] = 0;
    }
        
    if (BUFFER_SIZE / level_counters_max < OVERLOAD_DETECTION_THRESHOLD) {
      is_overload = 1;
    }
  }
    
  //Перегрузка      
  digitalWrite(OVERLOAD_LED, is_overload);

#ifdef APPLY_WINDOW  
  apply_blackman_window(data, LOG2_N_WAVE); // накладываем окно Блэкмана
#endif

  fix_fft(data, im, LOG2_N_WAVE, 0); // выполняем преобразование Фурье

  for(int i = 0; i < 3; i++) {
    channels[i] = 0;
    for (int j = band_defs[i].start_band; j <= band_defs[i].stop_band; j++) {
      channels[i] += FIX_MPY(data[j], data[j]) + FIX_MPY(im[j], im[j]);
    }
   
    channels[i] = sqrt_i(channels[i]);
   
    analogWrite(pwm_pins[i], signal_to_pwm(channels[i]));
  }
  
  for (int i = 1; i < N_WAVE / 2; i++) {
    data[i] = FIX_MPY(data[i], data[i]) + FIX_MPY(im[i], im[i]);
  }
  
  int16_t peak_index = 0, peak_value = 1;
  
  for (int i = 1; i < N_WAVE / 2; i++) {
    if (data[i] > peak_value) {
      peak_index = i;
      peak_value = data[i];
    }
  }
  
  band_data_t out[N_WAVE];
  int data_index = N_WAVE / 2 - 1;
  int out_index = 0;
  int16_t data_size = N_WAVE / 2 - 1;
  
  while (data_index > 0) {
    int16_t count = FIX_MPY(data_size, OUTPUT_LOG_BASE_FIX);
    
    if (count == 0) {
      count = 1;
    }
    
    out[out_index].band_count = count;
    
    int16_t next_data_size = data_size - count;
    int16_t sum = 0;
    
    while (data_index > 0 && count > 0) {
       sum += data[data_index--];
       count--;
    }
    
    out[out_index++].level = sqrt_i(sum);
    
    data_size = next_data_size; 
  }
  
  reverse(out, out_index);
  
  write_packet(out, out_index, INT16_MAX / 10, peak_index, OUTPUT_LOG_BASE_FIX, SAMPLE_FREQ, N_WAVE);
  
  free_adc_buffer();
}

